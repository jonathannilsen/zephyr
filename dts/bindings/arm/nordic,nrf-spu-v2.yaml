## dts/bindings/arm/nordic,nrf-spu-v2.yaml
```yaml
description: Nordic SPU (System Protection Unit) V2

compatible: "nordic,nrf-spu-v2"

include: base.yaml

properties:
  reg:
    required: true

  periph:
    type: array

  features:
    type: array
```

## modules/hal_nordic/ironside/se/Kconfig.sysbuild
```kconfig
# Copyright (c) 2025 Nordic Semiconductor ASA
# SPDX-License-Identifier: Apache-2.0

config HAS_IRONSIDE_SE
	bool

menu "IronSide SE"
	depends on HAS_IRONSIDE_SE

config NRF_HALTIUM_GENERATE_UICR
	bool "Generate UICR file"
	default y
	help
	  Generate UICR HEX file.

endmenu
```

## soc/nordic/common/uicr/Kconfig
```kconfig
# Copyright (c) 2025 Nordic Semiconductor ASA
# SPDX-License-Identifier: Apache-2.0

config NRF_HALTIUM_GENERATE_UICR
	bool "Generate UICR"
	depends on NRF_PLATFORM_HALTIUM

if NRF_HALTIUM_GENERATE_UICR

config NRF_HALTIUM_UICR_LOCK
	bool "Lock the UICR"

choice NRF_HALTIUM_UICR_APPROTECT_APPLICATION
	bool "APPLICATION AP protection"
	default NRF_HALTIUM_UICR_APPROTECT_APPLICATION_UNPROTECT

config NRF_HALTIUM_UICR_APPROTECT_APPLICATION_UNPROTECT
	bool "Enable all debugging"

config NRF_HALTIUM_UICR_APPROTECT_APPLICATION_PROTECT
	bool "Disable all debugging"

endchoice

choice NRF_HALTIUM_UICR_APPROTECT_RADIOCORE
	bool "RADIOCORE AP protection"
	default NRF_HALTIUM_UICR_APPROTECT_RADIOCORE_UNPROTECT

config NRF_HALTIUM_UICR_APPROTECT_RADIOCORE_UNPROTECT
	bool "Enable all debugging"

config NRF_HALTIUM_UICR_APPROTECT_RADIOCORE_PROTECT
	bool "Disable all debugging"

endchoice

choice NRF_HALTIUM_UICR_APPROTECT_CORESIGHT
	bool "CORESIGHT AP protection"
	default NRF_HALTIUM_UICR_APPROTECT_CORESIGHT_UNPROTECT

config NRF_HALTIUM_UICR_APPROTECT_CORESIGHT_UNPROTECT
	bool "Enable all debugging"

config NRF_HALTIUM_UICR_APPROTECT_CORESIGHT_PROTECT
	bool "Disable all debugging"

endchoice

config NRF_HALTIUM_UICR_ERASEPROTECT
	bool "Prevent ERASEALL"

config NRF_HALTIUM_UICR_PROTECTED_MEMORY
	bool "Enable protected memory region"

if NRF_HALTIUM_UICR_PROTECTED_MEMORY

config NRF_HALTIUM_UICR_PROTECTED_MEMORY_SIZE
	hex "Protected memory region size"
	default 0

endif

config NRF_HALTIUM_UICR_ITS
	bool "Enable Internal Trusted Storage"

if NRF_HALTIUM_UICR_ITS

config NRF_HALTIUM_UICR_ITS_ADDRESS
	hex "ITS start address"
	default 0

config NRF_HALTIUM_UICR_ITS_APPLICATION_SIZE
	hex "Size of the APPLICATION ITS region"
	default 0

config NRF_HALTIUM_UICR_ITS_RADIOCORE_SIZE
	hex "Size of the RADIOCORE ITS region"
	default 0

endif

config NRF_HALTIUM_UICR_PERIPHCONF
	bool "Enable peripheral configuration"
	default y

endif
```

## soc/nordic/common/uicr/Kconfig.sysbuild
```kconfig
config NRF_HALTIUM_GENERATE_UICR
	bool "Generate UICR file"
	depends on SOC_SERIES_NRF54HX
	default y
	help
	  Generate UICR HEX file.

if NRF_HALTIUM_GENERATE_UICR

config NRF_HALTIUM_UICR_PERIPHCONF
	bool "Initialize global domain peripherals"
	default y
	help
	  Generates a blob containing static global domain peripheral initialization
	  values extracted from the build artifacts, and configures UICR.PERIPHCONF
	  to point at the blob. The initialization values are then loaded ahead of
	  ahead of the application boot.

endif
```

## soc/nordic/ironside/Kconfig
```kconfig
# Copyright (c) 2025 Nordic Semiconductor ASA
# SPDX-License-Identifier: Apache-2.0

config HAS_NRF_IRONSIDE
	bool
	help
	  This is selected by SoCs that run Nordic IronSide firmware.

menu "Nordic IronSide"
	depends on HAS_NRF_IRONSIDE

config NRF_IRONSIDE
	bool
	help
	  This is selected by drivers interacting with Nordic IronSide firmware.

# Specific IronSide SE versions are listed here.
# Each version is listed both in string format and hexadecimal format.
# Hexadecimal format: hex( (major << 24) | (minor << 16) | (bugfix << 8) | (seqno) )
#
# When integrating a new version:
#
# * Add v<version>_str and v<version>_hex variables below this.
# * Update latest_version_str:
#     latest_version_str := "$(v<version>_str)".
# * Add a default case to NRF_IRONSIDE_VERSION that maps the string to the hex value:
#     default v<version>_hex if NRF_IRONSIDE_VERSION_STRING = "$(v<version>_str)".

v23_0_99_127_str := 23.0.99+127
v23_0_99_127_hex := 0x1700637f

default_version_str := $(v23_0_99_127_str)
latest_version_str := $(v23_0_99_127_str)

config NRF_IRONSIDE_VERSION
	hex
	default $(v23_0_99_127_hex) if NRF_IRONSIDE_VERSION_STRING = "$(v23_0_99_127_str)"
	default 0 # Invalid/unknown version
	help
	  Helper symbol that contains the targeted IronSide SE version, in hexadecimal format.

config NRF_IRONSIDE_VERSION_IS_KNOWN
	def_bool NRF_IRONSIDE_VERSION != 0
	help
	  Helper symbol that indicates if the targeted IronSide SE version is valid/known.

choice
	prompt "Target IronSide version"
	default NRF_IRONSIDE_VERSION_USE_DEFAULT
	help
	  Scheme used to determine the version of IronSide SE targeted by the application.
	  The target version is used to determine which APIs are supported and for choosing
	  the correct IronSide release blob.

config NRF_IRONSIDE_VERSION_USE_DEFAULT
	bool "Target the default version [$(default_version_str)]"
	help
	  Target the version set as the default. This is the version that is used for
	  general zephyr development.

config NRF_IRONSIDE_VERSION_USE_LATEST
	bool "Target the latest version [$(latest_version_str)]"
	help
	  Target the latest version available to in hal_nordic. This version supports
	  the latest IronSide features.

config NRF_IRONSIDE_VERSION_USE_FIXED
	bool "Target a fixed version"
	help
	  Target a specific version. It is recommended to use this option
	  in your application so that the IronSide libraries, drivers
	  and build system know which version of IronSide SE you are using.

endchoice

config NRF_IRONSIDE_FIXED_VERSION
	string "IronSide version to target"
	depends on NRF_IRONSIDE_VERSION_USE_FIXED
	default "$(default_version_str)"
	help
	  The specific version of IronSide SE to target.

config NRF_IRONSIDE_VERSION_STRING
	string
	default NRF_IRONSIDE_FIXED_VERSION if NRF_IRONSIDE_VERSION_USE_FIXED
	default "$(latest_version_str)" if NRF_IRONSIDE_VERSION_USE_LATEST
	default "$(default_version_str)" if NRF_IRONSIDE_VERSION_USE_DEFAULT
	help
	  Helper symbol that contains the targeted IronSide SE version, in string format.

config NRF_IRONSIDE_CALL
	bool
	depends on DT_HAS_NORDIC_IRONSIDE_CALL_ENABLED
	select NRF_IRONSIDE
	select EVENTS
	select MBOX
	help
	  This is selected by features that require support for IronSide calls.

if NRF_IRONSIDE_CALL

config NRF_IRONSIDE_CALL_INIT_PRIORITY
	int "IronSide calls' initialization priority"
	default 41
	help
	  Initialization priority of IronSide calls. It must be below MBOX_INIT_PRIORITY,
	  but higher than the priority of any feature that selects NRF_IRONSIDE_CALL.

endif # NRF_IRONSIDE_CALL

config NRF_IRONSIDE_CPUCONF_SERVICE
	bool "IronSide CPUCONF service"
	depends on SOC_NRF54H20_CPUAPP || SOC_NRF9280_CPUAPP
	select NRF_IRONSIDE_CALL
	help
	  Service used to boot local domain cores.

config NRF_IRONSIDE_TDD_SERVICE
	bool "IronSide TDD service"
	select NRF_IRONSIDE_CALL
	help
	  Service used to control the trace and debug domain.

config NRF_IRONSIDE_UPDATE_SERVICE
	bool "IronSide update service"
	select NRF_IRONSIDE_CALL
	help
	  Service used to update the IronSide SE firmware.

config NRF_IRONSIDE_BOOT_REPORT
	bool "IronSide boot report"
	depends on $(dt_nodelabel_exists,ironside_se_boot_report)
	select NRF_IRONSIDE
	help
	  Support for parsing the Boot Report populated by Nordic IronSide firmware.

config NRF_IRONSIDE_BOOTMODE_SERVICE
	bool "IronSide boot mode service"
	select NRF_IRONSIDE_CALL
	help
	  Service used to reboot into secondary firmware boot mode.

config NRF_IRONSIDE_DVFS_SERVICE
	bool "IronSide DVFS service"
	depends on SOC_NRF54H20_CPUAPP
	select NRF_IRONSIDE_CALL
	help
	  Service used to handle DVFS operating point requests.

if NRF_IRONSIDE_DVFS_SERVICE

config NRF_IRONSIDE_ABB_STATUSANA_CHECK_MAX_ATTEMPTS
	int "IRONSside DVFS ABB analog status check maximum attempts"
	range 0 255
	default 50
	help
	  Maximum attempts with 10us intervals before busy status will be reported.

endif # NRF_IRONSIDE_DVFS_SERVICE

endmenu
```

## tests/drivers/firmware/nrf_ironside/boot_report/testcase.yaml
```yaml
common:
  tags:
    - drivers
    - hwinfo
  harness: console

tests:
  drivers.firmware.nrf_ironside.boot_report:
    harness_config:
      type: multi_line
      ordered: true
      regex:
        - "err: 0"
        - "version: ([0-9]+\\.[0-9]+\\.[0-9]+-[0-9a-zA-Z]+\\+[0-9]+)"
        - "recovery version: ([0-9]+\\.[0-9]+\\.[0-9]+-[0-9a-zA-Z]+\\+[0-9]+)"
    platform_allow:
      - nrf54h20dk/nrf54h20/cpuapp/iron
    integration_platforms:
      - nrf54h20dk/nrf54h20/cpuapp/iron
```
